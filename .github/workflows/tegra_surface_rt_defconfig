## .github/workflows/tegra_surface_rt_defconfig
```kconfig
CONFIG_EFI_STUB=y 
CONFIG_EFI=y
CONFIG_FB=y
CONFIG_FB_EFI=y
CONFIG_FRAMEBUFFER_CONSOLE=y
CONFIG_I2C_HID_OF=y
CONFIG_I2C_HOTPLUG_GPIO=y
CONFIG_BATTERY_CHARGER_SURFACE_RT=y
CONFIG_MWIFIEX=y
CONFIG_MWIFIEX_SDIO=y
CONFIG_SND_SOC_TEGRA_WM8962=y
CONFIG_HID_MICROSOFT=y
CONFIG_HID_SENSOR_HUB=y
CONFIG_EFI_GENERIC_STUB_INITRD_CMDLINE_LOADER=y
CONFIG_HID_SENSOR_HUB=y
CONFIG_TEGRA_DEBUG_UARTA=y
```
